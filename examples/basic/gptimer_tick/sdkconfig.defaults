## examples/basic/gptimer_tick/sdkconfig.defaults
```kconfig
CONFIG_ESP32LIBFUN_SERIAL=y
CONFIG_ESP32LIBFUN_AT=y
CONFIG_ESP32LIBFUN_DELAY=y
CONFIG_ESP32LIBFUN_GPTIMER=y
CONFIG_ESP32LIBFUN_GPIO=n
CONFIG_ESP32LIBFUN_I2C=n
CONFIG_ESP32LIBFUN_SPI=n
CONFIG_ESP32LIBFUN_LEDC=n
CONFIG_ESP32LIBFUN_PCNT=n
CONFIG_ESP32LIBFUN_MCPWM=n
CONFIG_ESP32LIBFUN_RMT=n
CONFIG_ESP32LIBFUN_ADC=n
CONFIG_ESP32LIBFUN_TWAI=n
CONFIG_ESP32LIBFUN_WIFI_STA=n
CONFIG_ESP32LIBFUN_WEBSERVER=n
CONFIG_ESP32LIBFUN_W5500=n
CONFIG_ESP32LIBFUN_LAN8720=n
```

## examples/basic/spi_txrx/sdkconfig.defaults
```kconfig
CONFIG_ESP32LIBFUN_SERIAL=y
CONFIG_ESP32LIBFUN_AT=y
CONFIG_ESP32LIBFUN_DELAY=y
CONFIG_ESP32LIBFUN_GPIO=n
CONFIG_ESP32LIBFUN_I2C=n
CONFIG_ESP32LIBFUN_SPI=y
CONFIG_ESP32LIBFUN_LEDC=n
CONFIG_ESP32LIBFUN_PCNT=n
CONFIG_ESP32LIBFUN_MCPWM=n
CONFIG_ESP32LIBFUN_WIFI_STA=n
CONFIG_ESP32LIBFUN_WEBSERVER=n
CONFIG_ESP32LIBFUN_W5500=n
CONFIG_ESP32LIBFUN_LAN8720=n
```

## framework/core/esp32libfun/Kconfig
```kconfig
menu "ESP32LIBFUN"

    comment "For ESP32-C3/S3/C6/H2 boards with native USB, prefer ESP-IDF console = USB Serial/JTAG"

    config ESP32LIBFUN_SERIAL
        bool "Enable serial module"
        default y
        help
            Builds and exposes esp32libfun_serial.
            On targets with native USB, the recommended ESP-IDF console backend
            is USB Serial/JTAG because it avoids external USB-UART adapters and
            usually gives the smoothest first-run experience.

    config ESP32LIBFUN_AT
        bool "Enable AT console module"
        default y
        depends on ESP32LIBFUN_SERIAL
        help
            Builds and exposes esp32libfun_at.
            The AT console is initialized and started from esp32libfun_init().

    config ESP32LIBFUN_AT_MAX_CMDS
        int "Maximum AT commands"
        default 16
        depends on ESP32LIBFUN_AT
        range 1 128
        help
            Fixed-size AT registry capacity used by self-registering and manual commands.

    config ESP32LIBFUN_DELAY
        bool "Enable delay module"
        default y
        help
            Builds and exposes esp32libfun_delay.

    config ESP32LIBFUN_GPIO
        bool "Enable GPIO module"
        default y
        help
            Builds and exposes esp32libfun_gpio.

    config ESP32LIBFUN_LEDC
        bool "Enable LEDC PWM module"
        default y
        help
            Builds and exposes esp32libfun_ledc.

    config ESP32LIBFUN_I2C
        bool "Enable I2C module"
        default y
        help
            Builds and exposes esp32libfun_i2c.

    config ESP32LIBFUN_PCNT
        bool "Enable pulse counter module"
        default y
        depends on SOC_PCNT_SUPPORTED
        help
            Builds and exposes esp32libfun_pcnt.

    config ESP32LIBFUN_SPI
        bool "Enable SPI module"
        default y
        help
            Builds and exposes esp32libfun_spi.

    config ESP32LIBFUN_ADC
        bool "Enable ADC module"
        default y
        depends on SOC_ADC_SUPPORTED
        help
            Builds and exposes esp32libfun_adc.
            Thin wrapper over the ESP-IDF ADC oneshot driver with optional
            calibration for millivolt reads.

    config ESP32LIBFUN_GPTIMER
        bool "Enable GPTimer module"
        default y
        depends on SOC_GPTIMER_SUPPORTED
        help
            Builds and exposes esp32libfun_gptimer.
            Thin wrapper over the ESP-IDF general-purpose timer driver.

    config ESP32LIBFUN_RMT
        bool "Enable RMT module"
        default y
        depends on SOC_RMT_SUPPORTED
        help
            Builds and exposes esp32libfun_rmt.
            Thin wrapper over the ESP-IDF RMT TX/RX driver: channel lifecycle,
            carrier modulation, and byte/raw symbol transmission. Protocol
            logic (IR framing, WS2812 timing, etc.) belongs in esp_* libraries
            built on top.

    config ESP32LIBFUN_TWAI
        bool "Enable TWAI module"
        default y
        depends on SOC_TWAI_SUPPORTED
        help
            Builds and exposes esp32libfun_twai.
            Thin wrapper over the ESP-IDF TWAI node driver for CAN-style bus
            bring-up, loopback testing, frame TX/RX, filters, and status.

    config ESP32LIBFUN_W5500
        bool "Enable W5500 Ethernet module"
        default n
        help
            Builds and exposes esp32libfun_w5500.
            This module owns one dedicated SPI bus for the W5500 and wraps the
            official ESP-IDF Ethernet driver.

    config ESP32LIBFUN_LAN8720
        bool "Enable LAN8720 Ethernet module"
        default n
        depends on ETH_USE_ESP32_EMAC
        help
            Builds and exposes esp32libfun_lan8720.
            This module owns one internal EMAC + LAN87xx PHY path in RMII mode
            and wraps the official ESP-IDF Ethernet driver.

    config ESP32LIBFUN_MCPWM
        bool "Enable MCPWM module"
        default y
        depends on SOC_MCPWM_SUPPORTED
        help
            Builds and exposes esp32libfun_mcpwm.

    config ESP32LIBFUN_WIFI_STA
        bool "Enable Wi-Fi STA module"
        default y
        help
            Builds and exposes esp32libfun_wifi_sta.

    config ESP32LIBFUN_WEBSERVER
        bool "Enable webserver module"
        default y
        help
            Builds and exposes esp32libfun_webserver.

endmenu
```

## sdkconfig.defaults
```kconfig
# esp32libfun default configuration
# Common settings for all targets - do NOT set CONFIG_IDF_TARGET here.
# Use sdkconfig.defaults.<target> for target-specific overrides.

# esp32libfun modules
CONFIG_ESP32LIBFUN_SERIAL=y
CONFIG_ESP32LIBFUN_AT=y
CONFIG_ESP32LIBFUN_AT_MAX_CMDS=48
CONFIG_ESP32LIBFUN_DELAY=y
CONFIG_ESP32LIBFUN_GPIO=y
CONFIG_ESP32LIBFUN_LEDC=y
CONFIG_ESP32LIBFUN_I2C=y
CONFIG_ESP32LIBFUN_PCNT=y
CONFIG_ESP32LIBFUN_SPI=y
CONFIG_ESP32LIBFUN_MCPWM=y
CONFIG_ESP32LIBFUN_RMT=y
CONFIG_ESP32LIBFUN_ADC=y
CONFIG_ESP32LIBFUN_GPTIMER=y
CONFIG_ESP32LIBFUN_TWAI=y
```

## sdkconfig.defaults.esp32c3
```kconfig
# esp32c3-specific defaults
CONFIG_ESP_CONSOLE_USB_SERIAL_JTAG=y
CONFIG_ESPTOOLPY_FLASHSIZE_4MB=y
```

## sdkconfig.defaults.esp32s3
```kconfig
# esp32s3-specific defaults
CONFIG_ESP_CONSOLE_USB_SERIAL_JTAG=y
CONFIG_ESPTOOLPY_FLASHSIZE_4MB=y
```
